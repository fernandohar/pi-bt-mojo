## sdkconfig.defaults
```kconfig
# ---- Board / flash ----
CONFIG_ESPTOOLPY_FLASHSIZE_4MB=y
CONFIG_PARTITION_TABLE_SINGLE_APP_LARGE=y
CONFIG_ESP_DEFAULT_CPU_FREQ_MHZ_240=y

# ---- Main task ----
CONFIG_ESP_MAIN_TASK_STACK_SIZE=4096

# ---- Bluetooth: Classic (BR/EDR) only, Bluedroid host ----
CONFIG_BT_ENABLED=y
CONFIG_BTDM_CTRL_MODE_BR_EDR_ONLY=y
CONFIG_BTDM_CTRL_MODE_BLE_ONLY=n
CONFIG_BTDM_CTRL_MODE_BTDM=n
CONFIG_BT_BLUEDROID_ENABLED=y
CONFIG_BT_CLASSIC_ENABLED=y
CONFIG_BT_A2DP_ENABLE=y
CONFIG_BT_A2DP_USE_EXTERNAL_CODEC=y
CONFIG_BT_BLE_ENABLED=n

# ---- Log ----
CONFIG_LOG_DEFAULT_LEVEL_INFO=y
```
